## _modules/entity_lib/Kconfig
```kconfig
config FTEST_ENTITY
    bool "FTEST_ENTITY"
    default n
    help
      Designates this entity as an FTEST entity. This means that it will be 
      built as a dynamic library, and will be compiled with special drivers 
      for that framework.


if FTEST_ENTITY


config FTEST_ETH_OUTPUT_PCAP
    bool "FTEST_ETH_OUTPUT_PCAP"
    default n
    depends on NETWORKING
    help
      Enable PCAP output for Ethernet driver in the FTEST framework.


endif # FTEST_ENTITY
```

## _modules/entity_lib/dts/bindings/ftest,eth-inproc.yaml
```yaml
description: The driver for communication between entities in ftest framework

compatible: "ftest,eth-inproc"

properties:
  mac:
    type: uint8-array
    description: The mac address of the entity
    required: true
  ip:
    type: string
    description: The ip address of the entity
    required: true
  mask:
    type: string
    description: The network mask of the entity
    required: true
```

## _modules/runner_lib/Kconfig
```kconfig
config FTEST
    bool "FTEST"
    default y
    select ZTEST
    select FTEST_ENTITY
    help
      Enable the FTEST framework. This framework is used to test scenarios where
      several entities are involved, like network communication or complex
      interactions.


if FTEST


config FTEST_SHED_MAX_ENTITIES
    int "FTEST_SHED_MAX_ENTITIES"
    default 100
    help
      The maximum number of entities that can be handled by the FTEST sheduler.
      This value should be set based on the expected number of entities in your tests.
      Increasing this value allows for more entities to be managed simultaneously,
      but may require more memory.


endif # FTEST
```

## _modules/runner_lib/dts/bindings/ftest,dev-iface.yaml
```yaml
description:  The driver for accessing GPIO interfaces of entities in the FTest framework.

compatible: "ftest,dev-iface"

properties:
  remote-label:
    type: string
    description: The label by which the GPIO interface is referenced in the entity.
    required: true
```

## _modules/runner_lib/dts/bindings/ftest,entity-loader.yaml
```yaml
description: The driver for loading entities in the FTest framework.

compatible: "ftest,entity-loader"

properties:
  entity-path:
    type: string
    description: The path to the entity file to be loaded.
    required: true
```

## runner/testcase.yaml
```yaml
tests:
  # section.subsection
  sample.testing.ztest:
    platform_allow:
      - native_sim/native/64
    integration_platforms:
      - native_sim/native/64
    tags: test_framework
```
